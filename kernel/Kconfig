## kernel/Kconfig
```kconfig
menu "KernelSU"

config KSU
	tristate "KernelSU function support"
	depends on KPROBES && EXT4_FS
	default y
	help
	  Enable kernel-level root privileges on Android System.
	  Requires CONFIG_KPROBES for kernel hooking support.
	  Requires CONFIG_EXT4_FS for `ext4_unregister_sysfs`.
	  To compile as a module, choose M here: the
	  module will be called kernelsu.

config KSU_DEBUG
	bool "KernelSU debug mode"
	depends on KSU
	default n
	help
	  Enable KernelSU debug mode.

config KSU_DISABLE_MANAGER
	bool "Disable KernelSU manager integration"
	depends on KSU
	default n
	help
	  Disable manager APK detection and manager-specific handling.
	  Root will be used in place of manager-only functionality.

config KSU_DISABLE_POLICY
	bool "Disable KernelSU policy profiles"
	depends on KSU
	default n
	help
	  Disable per-app root/non-root profile customization.
	  Escalation will always use the default full root profile, and
	  non-root handling will follow the global umount policy only.

config KSU_SUSFS
	bool "Build KernelSU-Next SuSFS into the kernel"
	depends on KSU
	default y
	help
	  Compile KernelSU-Next's SuSFS (drivers/kernelsu/susfs) into the kernel image instead
	  of loading it at runtime as susfs_guard_lkm.ko. Graphite builds this in because the
	  husky kernel forces module signing and randomises struct layout, which stops any
	  externally built module from loading. SuSFS is armed from on_post_fs_data(), the same
	  point ksud would otherwise insmod the module. This is a root-hiding feature and
	  weakens the device's resistance to tampering detection; it is on because KernelSU
	  itself already is.

config KSU_X86_PATCH_SYSCALL_DISPATCHER
	bool "Dynamically patch x64's hardened syscall dispatcher to support syscall hooks"
	depends on KSU && X86_64
	default n
	help
	  Dynamically patch x64's hardened syscall dispatcher to support syscall hooks. This is a
	  replacement for a kernel source code patch, and is useful for x86_64 LKM mode.

endmenu
```
